## config/west.yml
```yaml
manifest:
  remotes:
    - name: chase-hunter
      url-base: https://github.com/chase-hunter
    - name: petejohanson
      url-base: https://github.com/petejohanson
    - name: m165437 #new entry
      url-base: https://github.com/M165437 #new entry
  projects:
    - name: zmk
      remote: petejohanson
      revision: feat/pointers-with-input-processors
      import: app/west.yml
    - name: nice-view-gem #new entry
      remote: m165437 #new entry
      revision: main #new entry
  self:
    path: config
```
